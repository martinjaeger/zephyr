## subsys/lorawan/fuota/Kconfig
```kconfig
# LoRaWAN Firmware-Upgrade Over The Air (FUOTA) configuration options
#
# Copyright (c) 2022 Martin Jäger <martin@libre.solar>
# SPDX-License-Identifier: Apache-2.0

menuconfig LORAWAN_FUOTA
	bool "LoRaWAN FUOTA service"
	depends on LORAWAN
	depends on ENTROPY_GENERATOR
	depends on FLASH_MAP
	depends on FLASH_PAGE_LAYOUT
	depends on BOOTLOADER_MCUBOOT
	depends on MCUBOOT_IMG_MANAGER
	help
	  Enables the LoRaWAN firmware-upgrade over the air (FUOTA)
	  background service.

	  The service uses a dedicated thread and a work queue. Once
	  started, it will wait for firmware images and write them into
	  the secondary flash partition.

if LORAWAN_FUOTA

module = LORAWAN_FUOTA
module-str = lorawan_fuota
source "subsys/logging/Kconfig.template.log_config"

config LORAWAN_FUOTA_THREAD_STACK_SIZE
	int "FUOTA thread stack size"
	default 2048
	help
	  Stack size of thread running the FUOTA service in the background.

config LORAWAN_FUOTA_THREAD_PRIORITY
	int "Thread priority"
	default 2
	help
	  Priority of the thread running the FUOTA service.

DT_CHOSEN_Z_CODE_PARTITION := zephyr,code-partition

config LORAWAN_FUOTA_IMAGE_SIZE
	int "Total size of firmware image"
	default $(dt_chosen_reg_size_int,$(DT_CHOSEN_Z_CODE_PARTITION))
	help
	  Size of the flash partition for the application firmware image
	  in bytes.

	  The minimum number of fragments to be transferred is calculated from
	  this value divided by the fragment size.

	  This setting has significant influence on RAM usage.

config LORAWAN_FUOTA_FRAG_SIZE
	int "Size of fragments for transport"
	range 1 239
	default 200
	help
	  Size of one fragment transferred during the fragmented data block
	  transport session of the FUOTA process.

	  The fragment has to fit into the LoRaWAN payload, which can be up to
	  242 bytes depending on the region and frequency settings. 3 bytes of
	  the payload are consumed for protocol information.

	  For some MCUs like the STM32WL the fragment size has to be a multiple
	  of 8 (see flash driver for further information).

	  This setting has significant influence on RAM usage.

config LORAWAN_FUOTA_FRAG_REDUNDANCY
	int "Percentage of redundant fragments"
	range 1 100
	default 10
	help
	  The built-in forward error correction (FEC) mechanism allows to
	  reconstruct missed packages from additional redundant packages
	  sent by the server after all packages have been sent.

	  This parameter specifies the maximum amount of packet loss (in
	  percent) for which it should be possible to reconstruct the full
	  firmware image.

	  This setting has significant influence on RAM usage.

config LORAWAN_APP_CLOCK_SYNC_VERSION
	int "Application Layer Clock Synchronization specification"
	range 1 2
	default 1
	help
	  The implementation considers different versions of the specification
	  released by the LoRa Alliance.

	  Select one of the following revisions:

	  1: TS003-1.0.0
	  2: TS003-2.0.0 (not fully supported, only for testing)

config LORAWAN_APP_CLOCK_SYNC_PERIODICITY
	int "Application Layer Clock Synchronization periodicity"
	range 128 4194304
	default 86400
	help
	  Initial setting for clock synchronization periodicity in seconds.

	  The value can be updated remotely by the application server within a
	  range from 128 (0x80) to 4194304 (0x400000).

	  Default setting: 24h.

config LORAWAN_FRAG_TRANSPORT_VERSION
	int "Fragmented Data Block Transport Specification"
	range 1 2
	default 1
	help
	  The implementation considers different versions of the specification
	  released by the LoRa Alliance.

	  Select one of the following revisions:

	  1: TS004-1.0.0
	  2: TS004-2.0.0 (not fully supported, only for testing)

config LORAWAN_REMOTE_MULTICAST_VERSION
	int "Remote Multicast Setup Specification"
	range 1 1
	default 1
	help
	  The implementation considers different versions of the specification
	  released by the LoRa Alliance.

	  Select one of the following revisions:

	  1: TS005-1.0.0
	  2: TS005-2.0.0 (not fully supported, only for testing)

endif # LORAWAN_FUOTA
```

## tests/subsys/lorawan/frag_decoder/testcase.yaml
```yaml
common:
  tags:
    - lorawan
tests:
  lorawan.frag_decoder.semtech:
    platform_allow:
      - native_sim
    extra_configs:
      - CONFIG_LORAWAN_FRAG_TRANSPORT_DECODER_SEMTECH=y
  lorawan.frag_decoder.lowmem:
    platform_allow:
      - native_sim
    extra_configs:
      - CONFIG_LORAWAN_FRAG_TRANSPORT_DECODER_LOWMEM=y
```
