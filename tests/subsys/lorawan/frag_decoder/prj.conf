## CMakeLists.txt
```
# SPDX-License-Identifier: Apache-2.0

cmake_minimum_required(VERSION 3.20.0)

find_package(Zephyr REQUIRED HINTS $ENV{ZEPHYR_BASE})
project(lorawan)

# Generate include files from binary firmware files
# (see tests/application_development/gen_inc_file for details)
set(gen_dir ${ZEPHYR_BINARY_DIR}/include/generated/)
generate_inc_file_for_target(app
        data/helloworld-stm32wl.signed.bin
        ${gen_dir}/fw_raw.bin.inc
)
generate_inc_file_for_target(app
        data/helloworld-stm32wl_with_fragments.signed.bin
        ${gen_dir}/fw_coded.bin.inc
)

FILE(GLOB app_sources src/*.c)
target_sources(app PRIVATE ${app_sources})
```

## prj.conf
```kconfig
# SPDX-License-Identifier: Apache-2.0

CONFIG_ZTEST=y

# General Zephyr settings
CONFIG_MAIN_STACK_SIZE=2048
CONFIG_SYSTEM_WORKQUEUE_STACK_SIZE=2048
CONFIG_THREAD_NAME=y
CONFIG_LOG=y

# LoRa PHY and required peripherals
CONFIG_LORA=y
CONFIG_SPI=y
CONFIG_GPIO=y

# NVS required to store LoRaWAN DevNonce
CONFIG_NVS=y
CONFIG_SETTINGS=y

# Random number generator required for several LoRaWAN services
CONFIG_ENTROPY_GENERATOR=y

# LoRaWAN application layer
CONFIG_LORAWAN=y
CONFIG_LORAMAC_REGION_EU868=y
CONFIG_LORAWAN_NVM_SETTINGS=y

# LoRaWAN services required for FUOTA
CONFIG_LORAWAN_SERVICES=y
CONFIG_LORAWAN_APP_CLOCK_SYNC=y
CONFIG_LORAWAN_REMOTE_MULTICAST=y
CONFIG_LORAWAN_FRAG_TRANSPORT=y

# Flash driver to store firmware image
CONFIG_FLASH=y
CONFIG_FLASH_MAP=y
CONFIG_FLASH_PAGE_LAYOUT=y
CONFIG_STREAM_FLASH=y
CONFIG_IMG_MANAGER=y
```

## boards/native_sim.conf
```kconfig
# SPDX-License-Identifier: Apache-2.0

# Turn off log messages for failed communication with non-existing LoRa PHY
CONFIG_LORA_LOG_LEVEL_OFF=y

# LoRaWAN Emulator doesn't need actual LoRa hardware access
CONFIG_LORAWAN_EMUL=y
```

## src/main.c
```c
/*
 * Copyright (c) 2024 A Labs GmbH
 * Copyright (c) 2024 tado GmbH
 *
 * SPDX-License-Identifier: Apache-2.0
 */

#include <zephyr/device.h>
#include <zephyr/kernel.h>
#include <zephyr/lorawan/lorawan.h>
#include <zephyr/lorawan/emul.h>
#include <zephyr/random/random.h>
#include <zephyr/sys/util.h>
#include <zephyr/storage/flash_map.h>
#include <zephyr/ztest.h>

#include "frag_encoder.h"

#define FRAG_SIZE       CONFIG_LORAWAN_FRAG_TRANSPORT_MAX_FRAG_SIZE
#define FIRMWARE_SIZE   (FRAG_SIZE * 100 + 1) /* not divisible by frag size to test padding */
#define UNCODED_FRAGS   (DIV_ROUND_UP(FIRMWARE_SIZE, FRAG_SIZE))
#define REDUNDANT_FRAGS UNCODED_FRAGS /* Redundancy of 100% for testing */
#define PADDING         (UNCODED_FRAGS * FRAG_SIZE - FIRMWARE_SIZE)

#define CMD_FRAG_SESSION_SETUP (0x02)
#define CMD_DATA_FRAGMENT      (0x08)
#define FRAG_TRANSPORT_PORT    (201)
#define FRAG_SESSION_INDEX     (1)

#define TARGET_IMAGE_AREA FIXED_PARTITION_ID(slot1_partition)

/* below array would normally hold the actual firmware binary */
static uint8_t fw_uncoded[FIRMWARE_SIZE];

/* enough space for redundancy of up to 100% */
static uint8_t fw_coded[(UNCODED_FRAGS + REDUNDANT_FRAGS) * FRAG_SIZE];

static const struct flash_area *fa;

static struct k_sem fuota_finished_sem;

static const uint8_t frag_session_setup_req[] = {
	CMD_FRAG_SESSION_SETUP,
	0x1f,
	UNCODED_FRAGS & 0xFF,
	(UNCODED_FRAGS >> 8) & 0xFF,
	FRAG_SIZE,
	0x01,
	PADDING,
	0x00,
	0x00,
	0x00,
	0x00,
};

static void fuota_finished(void)
{
	k_sem_give(&fuota_finished_sem);
}

ZTEST(frag_decoder, test_successful_decoding)
{
	uint8_t buf[256]; /* maximum size of one LoRaWAN message */
	int ret;

	k_sem_reset(&fuota_finished_sem);

	lorawan_emul_send_downlink(FRAG_TRANSPORT_PORT, false, 0, 0, sizeof(frag_session_setup_req),
				   frag_session_setup_req);

	for (int i = 0; i < sizeof(fw_coded) / FRAG_SIZE; i++) {
		if (i % 10 == 9) {
			/* loose every 10th packet */
			continue;
		}
		buf[0] = CMD_DATA_FRAGMENT;
		buf[1] = (i + 1) & 0xFF;
		buf[2] = (FRAG_SESSION_INDEX << 6) | ((i + 1) >> 8);
		memcpy(buf + 3, fw_coded + i * FRAG_SIZE, FRAG_SIZE);
		lorawan_emul_send_downlink(FRAG_TRANSPORT_PORT, false, 0, 0, FRAG_SIZE + 3, buf);
	}

	for (int i = 0; i < UNCODED_FRAGS; i++) {
		size_t num_bytes = (i == UNCODED_FRAGS - 1) ? (FRAG_SIZE - PADDING) : FRAG_SIZE;

		flash_area_read(fa, i * FRAG_SIZE, buf, num_bytes);
		zassert_mem_equal(buf, fw_coded + i * FRAG_SIZE, num_bytes, "fragment %d invalid",
				  i + 1);
	}

	ret = k_sem_take(&fuota_finished_sem, K_MSEC(100));
	zassert_equal(ret, 0, "FUOTA finish timed out");
}

ZTEST(frag_decoder, test_too_few_fragments)
{
	uint8_t buf[256]; /* maximum size of one LoRaWAN message */
	int ret;

	k_sem_reset(&fuota_finished_sem);

	lorawan_emul_send_downlink(FRAG_TRANSPORT_PORT, false, 0, 0, sizeof(frag_session_setup_req),
				   frag_session_setup_req);

	for (int i = 0; i < sizeof(fw_coded) / FRAG_SIZE; i++) {
		if (i % 3 == 2) {
			/* loose every 3rd packet */
			continue;
		}
		buf[0] = CMD_DATA_FRAGMENT;
		buf[1] = (i + 1) & 0xFF;
		buf[2] = (FRAG_SESSION_INDEX << 6) | ((i + 1) >> 8);
		memcpy(buf + 3, fw_coded + i * FRAG_SIZE, FRAG_SIZE);
		lorawan_emul_send_downlink(FRAG_TRANSPORT_PORT, false, 0, 0, FRAG_SIZE + 3, buf);
	}

	for (int i = 0; i < UNCODED_FRAGS; i++) {
		size_t num_bytes = (i == UNCODED_FRAGS - 1) ? (FRAG_SIZE - PADDING) : FRAG_SIZE;

		flash_area_read(fa, i * FRAG_SIZE, buf, num_bytes);
		zassert_mem_equal(buf, fw_coded + i * FRAG_SIZE, num_bytes, "fragment %d invalid",
				  i + 1);
	}

	ret = k_sem_take(&fuota_finished_sem, K_MSEC(100));
	zassert_equal(ret, 0, "FUOTA finish timed out");
}

static void *frag_decoder_setup(void)
{
	const struct device *lora_dev = DEVICE_DT_GET(DT_ALIAS(lora0));
	struct lorawan_join_config join_cfg = {0};
	int ret;

	/* populate firmware image with random data */
	sys_rand_get(fw_uncoded, sizeof(fw_uncoded));

	/* create coded data (including redundant fragments) from firmware image */
	ret = lorawan_frag_encoder(fw_uncoded, sizeof(fw_uncoded), fw_coded, sizeof(fw_coded),
				   FRAG_SIZE, REDUNDANT_FRAGS);
	zassert_equal(ret, 0, "creating coded data failed: %d", ret);

	k_sem_init(&fuota_finished_sem, 0, 1);

	ret = flash_area_open(TARGET_IMAGE_AREA, &fa);
	zassert_equal(ret, 0, "opening flash area failed: %d", ret);

	zassert_true(device_is_ready(lora_dev), "LoRa device not ready");

	ret = lorawan_start();
	zassert_equal(ret, 0, "lorawan_start failed: %d", ret);

	ret = lorawan_join(&join_cfg);
	zassert_equal(ret, 0, "lorawan_join failed: %d", ret);

	lorawan_frag_transport_run(fuota_finished);

	return NULL;
}

ZTEST_SUITE(frag_decoder, NULL, frag_decoder_setup, NULL, NULL, NULL);
```
